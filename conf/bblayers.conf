## conf/bblayers.conf
```bitbake
# POKY_BBLAYERS_CONF_VERSION is increased each time build/conf/bblayers.conf
# changes incompatibly
POKY_BBLAYERS_CONF_VERSION = "2"

BBPATH = "${TOPDIR}"
BBFILES ?= ""

BBLAYERS ?= " \
  /home/jtal/Documents/12204_yocto_mig/gsrd-socfpga/poky/meta \
  /home/jtal/Documents/12204_yocto_mig/gsrd-socfpga/poky/meta-poky \
  /home/jtal/Documents/12204_yocto_mig/gsrd-socfpga/poky/meta-yocto-bsp \
  /home/jtal/Documents/12204_yocto_mig/gsrd-socfpga/meta-intel-fpga \
  /home/jtal/Documents/12204_yocto_mig/gsrd-socfpga/meta-intel-fpga-refdes \
  /home/jtal/Documents/12204_yocto_mig/gsrd-socfpga/meta-openembedded/meta-oe \
  /home/jtal/Documents/12204_yocto_mig/gsrd-socfpga/meta-openembedded/meta-python \
  /home/jtal/Documents/12204_yocto_mig/gsrd-socfpga/meta-openembedded/meta-networking \
  /home/jtal/Documents/12204_yocto_mig/gsrd-socfpga/meta-clang \
  "
```

## conf/machine/cyan.conf
```bitbake
#@TYPE: Machine
#@NAME: Per Vices Chestnut
#@DESCRIPTION: Layer for Per Vices Cyan SDR Platform

# Require the meta-intel-fpga config
require conf/machine/stratix10_htile.conf

UBOOT_CONFIG = "stratix10-socdk-atf"

WKS_FILE = "cyan.wks"

MACHINE_ESSENTIAL_EXTRA_RRECOMMENDS:append = " \
    kernel-modules \
    device-tree \
    "

EXTRA_IMAGEDEPENDS:append:stratix10_htile = " \
    u-boot-socfpga-scr \
    u-boot-socfpga-env \
    "

# IMAGE_BOOT_FILES = " \
#     boot.scr.uimg \
#     u-boot.itb \
#     kernel.itb \
#     "
```

## conf/meta-intel-fpga-refdes/conf/machine/arria5-gsrd.conf
```bitbake
#@TYPE: Machine
#@NAME: arria5
#@DESCRIPTION: Machine configuration for the Arria V SoC" 

IMAGE_TYPE:arria5 ?= "gsrd"

KERNEL_IMAGETYPE = "zImage"
KERNEL_DEVICETREE:arria5 = "intel/socfpga/socfpga_arria5_socdk.dtb"

EXTRA_IMAGEDEPENDS:append:arria5 = " hw-ref-design u-boot-socfpga-scr"

UBOOT_EXTLINUX_FDT_default = "../socfpga_arria5_socdk.dtb"
UBOOT_EXTLINUX_ROOT = "root=/dev/mmcblk0p2"
UBOOT_EXTLINUX_FDTDIR_default ?= "../"
UBOOT_EXTLINUX_KERNEL_ARGS_default ?= "rootwait rw earlycon"

IMAGE_BOOT_FILES:arria5 = " \
	socfpga_arria5_socdk.dtb \
	${KERNEL_IMAGETYPE} \
	extlinux.conf;extlinux/extlinux.conf \
	u-boot.scr \
        ${MACHINE}_${IMAGE_TYPE}_ghrd/soc_system.rbf;soc_system.rbf \
	"
```

## meta-pervices/conf/machine/stratix10_htile.conf
```bitbake
#@TYPE: Machine
#@NAME: Altera SoCFPGA Stratix10
#@DESCRIPTION: Machine configuration for the Stratix 10 SoCFPGA

require conf/machine/include/socfpga_armv8a.inc
require conf/machine/include/ubifs.inc

KBUILD_DEFCONFIG ?= "defconfig"

IMAGE_TYPE:stratix10_htile ?= "gsrd"

UBOOT_CONFIG ??= "stratix10-socdk-atf"
UBOOT_CONFIG[stratix10-socdk] = "socfpga_stratix10_legacy_defconfig"
UBOOT_CONFIG[stratix10-socdk-atf] = "socfpga_stratix10_defconfig"
UBOOT_CONFIG[stratix10-socdk-qspi] = "socfpga_stratix10_qspi_legacy_defconfig"
UBOOT_CONFIG[stratix10-socdk-qspi-atf] = "socfpga_stratix10_defconfig"

UBOOT_BINARY = "u-boot.itb"
UBOOT_SUFFIX = "itb"

KERNEL_CLASSES:append = " kernel-fitimage"
KERNEL_IMAGETYPE = "Image"

LINUX_DTB_FILE ?= "socfpga_stratix10_socdk.dtb"
KERNEL_DEVICETREE ?= "altera/${LINUX_DTB_FILE}"
UBOOT_ENTRYPOINT = "0x4000000"
UBOOT_LOADADDRESS = "0x4000000"
FIT_KERNEL_COMP_ALG = "none"

SERIAL_CONSOLES ?= "115200;ttyS0"

EXTRA_IMAGECMD:jffs2 ?= "-n -q -e 0x10000"

UBOOT_EXTLINUX ?= "1"
UBOOT_EXTLINUX_LABELS ?= "default"
UBOOT_EXTLINUX_DEFAULT_LABEL ?= "Stratix10 SOCDK SDMMC"

UBOOT_EXTLINUX_MENU_DESCRIPTION:default ?= "Stratix10 SOCDK SDMMC"
UBOOT_EXTLINUX_KERNEL_IMAGE:default ?= "../${KERNEL_IMAGETYPE}"
UBOOT_EXTLINUX_FDTDIR:default ?= ".."
UBOOT_EXTLINUX_CONSOLE ?= "console=ttyS0,115200n8"
UBOOT_EXTLINUX_KERNEL_ARGS:default ?= "rootwait rw earlyprintk"
UBOOT_EXTLINUX_ROOT:default ?= "root=/dev/mmcblk0p2"

MACHINE_ESSENTIAL_EXTRA_RRECOMMENDS:append:stratix10_htile = " \
		kernel-modules \
		device-tree \
		"

# EXTRA_IMAGEDEPENDS:append:stratix10_htile = " \
# 		u-boot-socfpga-scr \
# 		u-boot-socfpga-env-var \
# 		"

# IMAGE_BOOT_FILES:stratix10_htile = " \
# 		${UBOOT_BINARY} \
# 		boot.scr.uimg \
# 		u-boot.itb \
# 		kernel.itb \
# 		Image \
# 		"


Add variables for wic creation of sdcard image
IMAGE_BOOT_FILES ?= " \
			${UBOOT_BINARY} \
			Image \
			socfpga_stratix10_socdk.dtb \
		    "

WKS_FILE ?= "sdimage.wks"
IMAGE_FSTYPES:append = " wic"
```
