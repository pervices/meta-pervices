## common/conf/layer.conf
```bitbake
# We have a conf directory, append it to BBPATH
BBPATH .= ":${LAYERDIR}"

# We have a recipes directory, add to BBFILES
BBFILES += "${LAYERDIR}/recipes*/*/*.bb ${LAYERDIR}/recipes*/*/*.bbappend"

BBFILE_COLLECTIONS += "pervices-common"
BBFILE_PRIORITY_pervices-common = "1"
BBFILE_PATTERN_pervices-common = "^${LAYERDIR}"
```

## conf/bblayers.conf.sample
```bitbake
# LAYER_CONF_VERSION is increased each time build/conf/bblayers.conf
# changes incompatibly
LCONF_VERSION = "6"

BBPATH = "${TOPDIR}"
BBFILES ?= ""

BBLAYERS ?= " \
  /home/sfeng/pv/vaunt/release/src/yocto-dizzy-2016-08-12-15-56/poky/meta \
  /home/sfeng/pv/vaunt/release/src/yocto-dizzy-2016-08-12-15-56/poky/meta-yocto \
  /home/sfeng/pv/vaunt/release/src/yocto-dizzy-2016-08-12-15-56/poky/meta-yocto-bsp \
  /home/sfeng/pv/vaunt/release/src/yocto-dizzy-2016-08-12-15-56/poky/meta-altera \
  /home/sfeng/pv/vaunt/release/src/yocto-dizzy-2016-08-12-15-56/poky/meta-linaro/meta-linaro-toolchain \
  /home/sfeng/pv/vaunt/release/src/yocto-dizzy-2016-08-12-15-56/poky/meta-pervices/common \
  /home/sfeng/pv/vaunt/release/src/yocto-dizzy-2016-08-12-15-56/poky/meta-openembedded/meta-oe \
  /home/sfeng/pv/vaunt/release/src/yocto-dizzy-2016-08-12-15-56/poky/meta-openembedded/meta-webserver \
  /home/sfeng/pv/vaunt/release/src/yocto-dizzy-2016-08-12-15-56/poky/meta-openembedded/meta-filesystems \
  /home/sfeng/pv/vaunt/release/src/yocto-dizzy-2016-08-12-15-56/poky/meta-openembedded/meta-networking \
  /home/sfeng/pv/vaunt/release/src/yocto-dizzy-2016-08-12-15-56/poky/meta-openembedded/meta-python \
  "
BBLAYERS_NON_REMOVABLE ?= " \
  /home/sfeng/pv/vaunt/release/src/yocto-dizzy-2016-08-12-15-56/poky/meta \
  /home/sfeng/pv/vaunt/release/src/yocto-dizzy-2016-08-12-15-56/poky/meta-yocto \
  "
```

## conf/layer.conf
```bitbake
# We have a conf directory, append it to BBPATH
BBPATH .= ":${LAYERDIR}"

# We have a recipes directory, add to BBFILES
BBFILES += "${LAYERDIR}/recipes*/*/*.bb ${LAYERDIR}/recipes*/*/*.bbappend"

BBFILE_COLLECTIONS += "meta-pervices"
BBFILE_PRIORITY_meta-pervices = "10"
BBFILE_PATTERN_meta-pervices = "^${LAYERDIR}"
LAYERSERIES_COMPAT_meta-pervices = "scarthgap"
#HOSTTOOLS += "avr-gcc avr-ar avr-objcopy avr-objdump avr-size avr-nm arm-linux-gnueabihf-gcc"
```

## conf/machine/chestnut.conf
```bitbake
#@TYPE: Machine
#@NAME: Per Vices Chestnut
#@DESCRIPTION: Layer for Per Vices Cyan SDR Platform

require conf/machine/stratix10.conf

UBOOT_BINARY = "u-boot-dtb.img"

IMAGE_FSTYPES += "wic wic.bmap"

WKS_FILE = "chestnut.wks"

IMAGE_BOOT_FILES ?= " \
                        ${UBOOT_BINARY} \
                        ${KERNEL_IMAGETYPE} \
                        socfpga_stratix10_socdk.dtb \
                        u-boot.scr \
                    "

do_image_wic[depends] += "mtools-native:do_populate_sysroot dosfstools-native:do_populate_sysroot virtual/bootloader:do_deploy virtual/kernel:do_deploy"
```

## conf/machine/crimson-rtm9.conf
```bitbake
#@TYPE: Machine
#@NAME: Per Vices Crimson pre RTM9 SDR platform
#@DESCRIPTION: Layer for Per Vices Crimson pre RTM9 SDR Platform
# Add variables for wic creation of sdcard image

require conf/machine/arria5.conf

UBOOT_BINARY = "u-boot-arria5.img"

KERNEL_IMAGETYPE = "zImage"

IMAGE_FSTYPES += "wic"

WKS_FILE = "crimson.wks"

IMAGE_BOOT_FILES ?= " \
                        ${UBOOT_BINARY} \
                        ${KERNEL_IMAGETYPE} \
                        socfpga_arria5_socdk.dtb \
			u-boot.scr \
                    "

do_image_wic[depends] += "mtools-native:do_populate_sysroot dosfstools-native:do_populate_sysroot virtual/bootloader:do_deploy virtual/kernel:do_deploy"
```

## conf/machine/crimson.conf
```bitbake
#@TYPE: Machine
#@NAME: Per Vices Crimson pre RTM9 SDR platform
#@DESCRIPTION: Layer for Per Vices Crimson pre RTM9 SDR Platform
# Add variables for wic creation of sdcard image

require conf/machine/arria5.conf

FPGA_IMAGE = "soc_system.rbf"

KERNEL_IMAGETYPE = "zImage"
KERNEL_DEVICETREE = "intel/socfpga/socfpga_arria5_socdk.dtb"

IMAGE_FSTYPES += "wic wic.bmap"

WKS_FILE = "crimson.wks"

UBOOT_CONFIG = "arria5"
UBOOT_CONFIG[arria5] = "socfpga_arria5_defconfig"

UBOOT_EXTLINUX ?= "1"
UBOOT_EXTLINUX_LABELS ?= "default"
UBOOT_EXTLINUX_DEFAULT_LABEL ?= "Arria5 SOCDK"

UBOOT_EXTLINUX_FDT_default ?= "../socfpga_arria5_socdk.dtb"
UBOOT_EXTLINUX_ROOT = "root=/dev/mmcblk0p3"
UBOOT_EXTLINUX_MENU_DESCRIPTION_default ?= "Arria5 SOCDK"
UBOOT_EXTLINUX_KERNEL_IMAGE_default ?= "../${KERNEL_IMAGETYPE}"
UBOOT_EXTLINUX_FDTDIR_default ?= "../"
UBOOT_EXTLINUX_KERNEL_ARGS_default ?= "rootwait rw earlycon"

IMAGE_BOOT_FILES ?= " \
                        ${FPGA_IMAGE} \
                        ${KERNEL_IMAGETYPE} \
                        socfpga_arria5_socdk.dtb;intel/socfpga/socfpga_arria5_socdk \
                        socfpga.dtb \
                        u-boot.scr \
                        extlinux.conf;extlinux/extlinux.conf \
                    "

do_image_wic[depends] += "mtools-native:do_populate_sysroot dosfstools-native:do_populate_sysroot virtual/bootloader:do_deploy virtual/kernel:do_deploy"
```

## conf/machine/cyan-4r4t-3g.conf
```bitbake
#@TYPE: Machine
#@NAME: Per Vices Cyan 4R4T 3GSPS SDR platform
#@DESCRIPTION: Layer for Per Vices Cyan 4R4T 3GSPS SDR Platform
# Add variables for wic creation of sdcard image

require conf/machine/stratix10.conf

UBOOT_BINARY = "u-boot-dtb.img"

IMAGE_FSTYPES += "wic"

WKS_FILE = "4r4t-3g.wks"

IMAGE_BOOT_FILES ?= " \
                        ${UBOOT_BINARY} \
                        ${KERNEL_IMAGETYPE} \
                        socfpga_stratix10_socdk.dtb \
			u-boot.scr \
                    "

do_image_wic[depends] += "mtools-native:do_populate_sysroot dosfstools-native:do_populate_sysroot virtual/bootloader:do_deploy virtual/kernel:do_deploy"
```

## conf/machine/cyan-8r8t-1g.conf
```bitbake
#@TYPE: Machine
#@NAME: Per Vices Cyan 8R8T 1GSPS SDR platform
#@DESCRIPTION: Layer for Per Vices Cyan 8R8T 1GSPS SDR Platform
# Add variables for wic creation of sdcard image

require conf/machine/stratix10.conf

UBOOT_BINARY = "u-boot-dtb.img"

IMAGE_FSTYPES += "wic"

WKS_FILE = "8r8t-1g.wks"

IMAGE_BOOT_FILES ?= " \
                        ${UBOOT_BINARY} \
                        ${KERNEL_IMAGETYPE} \
                        socfpga_stratix10_socdk.dtb \
			u-boot.scr \
                    "

do_image_wic[depends] += "mtools-native:do_populate_sysroot dosfstools-native:do_populate_sysroot virtual/bootloader:do_deploy virtual/kernel:do_deploy"
```

## conf/machine/stratix10-extra.conf
```bitbake
#@TYPE: Machine
#@NAME: Per Vices Cyan SDR platform
#@DESCRIPTION: Layer for Per Vices Cyan SDR Platform
# Add variables for wic creation of sdcard image

UBOOT_BINARY = "u-boot-dtb.img"

IMAGE_FSTYPES += "wic"

WKS_FILE = "4r4t-1g.wks"

IMAGE_BOOT_FILES ?= " \
                        ${UBOOT_BINARY} \
                        ${KERNEL_IMAGETYPE} \
                        socfpga_stratix10_socdk.dtb \
			u-boot.scr \
                    "

do_image_wic[depends] += "mtools-native:do_populate_sysroot dosfstools-native:do_populate_sysroot virtual/bootloader:do_deploy virtual/kernel:do_deploy"
```

## scripts/lib/wic/canned-wks/4r4t-1g.wks
```
# short-description: Create SD card image for Per Vices Cyan 4R4T 1GSPS platform
# long-description: Creates a partitioned SD card image for the Per Vices
# Cyan 4R4T 1GSPS platform. Boot files are located in the first vfat partition.

part --source bootimg-partition --ondisk mmcblk --fstype=vfat --label boot --active --align 4 --size 100
part / --source rootfs --ondisk mmcblk --fstype=ext4 --label root --align 4
```

## scripts/lib/wic/canned-wks/crimson.wks
```
# short-description: Create SD card image for Per Vices Crimson SDR platform
# long-description: Creates a partitioned SD card image for the Per Vices
# Crimson SDR platform. Boot files are located in the first vfat partition.

part --source bootimg-partition --ondisk mmcblk --fstype=vfat --label boot --active --system-id=b --align 1024 --size 16
part / --source rootfs --ondisk mmcblk --fstype=ext4 --label root --align 1024
part --source rawcopy --sourceparams="file=preloader-u-boot-arria5.img" --ondisk mmcblk --system-id=a2 --align 1024 --size 50
```

## scripts/lib/wic/canned-wks/cyan.wks
```
# short-description: Create SD card image for Per Vices Cyan SDR platform
# long-description: Creates a partitioned SD card image for the Per Vices
# Cyan SDR platform. Boot files are located in the first vfat partition.

part --source bootimg-partition --ondisk mmcblk --fstype=vfat --label boot --active --align 4 --size 100
part / --source rootfs --ondisk mmcblk --fstype=ext4 --label root --align 4
```
